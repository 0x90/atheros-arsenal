## ath9k-hmac/backports-3.12.8-1/net/nfc/Kconfig
```kconfig
#
# NFC sybsystem configuration
#

menuconfig NFC
	depends on !BACKPORT_KERNEL_3_1
	depends on NET
	depends on RFKILL || !RFKILL
	tristate "NFC subsystem support"
	depends on m
	default n
	help
	  Say Y here if you want to build support for NFC (Near field
	  communication) devices.

	  To compile this support as a module, choose M here: the module will
	  be called nfc.

source "net/nfc/nci/Kconfig"
source "net/nfc/hci/Kconfig"

source "drivers/nfc/Kconfig"
```

## jaldimac/kerneldriver/Kconfig
```kconfig
config JALDI
	tristate "Atheros 802.11n wireless cards support"
	depends on PCI
	---help---
	  This is the Jaldi module.
```
